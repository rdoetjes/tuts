@ RP2040 Hardware Constants

.equ SIO_BASE,                  0xd0000000
.equ SIO_GPIO_OUT_SET_OFFSET,   0x00000014
.equ SIO_GPIO_OUT_CLR_OFFSET,   0x00000018
.equ SIO_GPIO_OUT_XOR_OFFSET,   0x0000001c
.equ SIO_GPIO_OE_SET_OFFSET,    0x00000024
.equ SIO_GPIO_IN_OFFSET,        0x00000008

.equ IO_BANK0_BASE,             0x40014000
.equ GPIO0_CTRL_OFFSET,         0x00000004
.equ GPIO1_CTRL_OFFSET,         0x0000000c
.equ GPIO25_CTRL_OFFSET,        0x000000c8

.equ PADS_BANK0_BASE,           0x4001c000
.equ PADS_BANK0_GPIO25_OFFSET,  0x00000068

@ RP2040 PL011 UART
.equ UART0_BASE,                0x40034000
.equ UART1_BASE,                0x40038000
.equ UART_DR_OFFSET,            0x00000000
.equ UART_FR_OFFSET,            0x00000018
.equ UART_IBRD_OFFSET,          0x00000024
.equ UART_FBRD_OFFSET,          0x00000028
.equ UART_LCR_H_OFFSET,         0x0000002c
.equ UART_CR_OFFSET,            0x00000030

.equ UART_FR_TXFF_BITS,         0x00000020 @ Transmit FIFO full
.equ UART_FR_RXFE_BITS,         0x00000010 @ Receive FIFO empty

@ QEMU MPS2 AN385 CMSDK UART
@ Used for testing the Forth logic when running in QEMU
.equ CMSDK_UART0_BASE,          0x40004000
.equ CMSDK_UART_DATA_OFFSET,    0x00000000
.equ CMSDK_UART_STATE_OFFSET,   0x00000004
.equ CMSDK_UART_CTRL_OFFSET,    0x00000008
.equ CMSDK_UART_BAUDDIV_OFFSET, 0x00000010

.equ CMSDK_UART_STATE_TXFULL,   0x00000001
.equ CMSDK_UART_STATE_RXFULL,   0x00000002

.equ RESETS_BASE,               0x4000c000
.equ RESETS_RESET_OFFSET,       0x00000000
.equ RESETS_WDSEL_OFFSET,       0x00000004
.equ RESETS_RESET_DONE_OFFSET,  0x00000008

@ Atomic access aliases
.equ ATOMIC_CLR_OFFSET,         0x00003000

.equ RESETS_RESET_IO_BANK0_BITS, 0x00000020
.equ RESETS_RESET_PADS_BANK0_BITS, 0x00000100
.equ RESETS_RESET_UART0_BITS,    0x00010000

.equ XOSC_BASE,                 0x40024000
.equ CLOCKS_BASE,               0x40008000
